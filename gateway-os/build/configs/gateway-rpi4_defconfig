## gateway-os/build/configs/gateway-rpi4_defconfig
```kconfig
# Gateway OS Configuration for Raspberry Pi 4
# Buildroot configuration for VPN gateway appliance

BR2_aarch64=y
BR2_cortex_a72=y

# System configuration
BR2_SYSTEM_HOSTNAME="gateway"
BR2_SYSTEM_BANNER="Gateway OS - VPN Gateway Appliance"
BR2_SYSTEM_DHCP="eth0"
BR2_ROOTFS_OVERLAY="$(BR2_EXTERNAL_GATEWAY_PATH)/rootfs"
BR2_ROOTFS_POST_BUILD_SCRIPT="$(BR2_EXTERNAL_GATEWAY_PATH)/scripts/post-build.sh"
BR2_ROOTFS_POST_IMAGE_SCRIPT="$(BR2_EXTERNAL_GATEWAY_PATH)/scripts/post-image.sh board/raspberrypi4-64/post-image.sh"

# Kernel
BR2_LINUX_KERNEL=y
BR2_LINUX_KERNEL_CUSTOM_TARBALL=y
BR2_LINUX_KERNEL_CUSTOM_TARBALL_LOCATION="$(call github,raspberrypi,linux,rpi-6.6.y)/linux-rpi-6.6.y.tar.gz"
BR2_LINUX_KERNEL_DEFCONFIG="bcm2711"
BR2_LINUX_KERNEL_DTS_SUPPORT=y
BR2_LINUX_KERNEL_INTREE_DTS_NAME="broadcom/bcm2711-rpi-4-b"
BR2_LINUX_KERNEL_NEEDS_HOST_OPENSSL=y

# Bootloader
BR2_TARGET_RPI_FIRMWARE=y
BR2_TARGET_RPI_FIRMWARE_VARIANT_PI4=y
BR2_TARGET_RPI_FIRMWARE_CONFIG_FILE="$(BR2_EXTERNAL_GATEWAY_PATH)/bootloader/config.txt"

# Filesystem
BR2_TARGET_ROOTFS_EXT2=y
BR2_TARGET_ROOTFS_EXT2_4=y
BR2_TARGET_ROOTFS_EXT2_SIZE="512M"
BR2_PACKAGE_HOST_DOSFSTOOLS=y
BR2_PACKAGE_HOST_GENIMAGE=y
BR2_PACKAGE_HOST_MTOOLS=y

# Toolchain
BR2_TOOLCHAIN_BUILDROOT_GLIBC=y
BR2_PACKAGE_GLIBC_UTILS=y

# System tools
BR2_PACKAGE_BUSYBOX=y
BR2_PACKAGE_BUSYBOX_CONFIG="$(BR2_EXTERNAL_GATEWAY_PATH)/configs/busybox.config"
BR2_PACKAGE_SKELETON_INIT_SYSTEMD=y
BR2_PACKAGE_SYSTEMD=y
BR2_PACKAGE_SYSTEMD_NETWORKD=y
BR2_PACKAGE_SYSTEMD_RESOLVED=y

# Network packages
BR2_PACKAGE_IPTABLES=y
BR2_PACKAGE_IPROUTE2=y
BR2_PACKAGE_WIRELESS_TOOLS=y
BR2_PACKAGE_WPA_SUPPLICANT=y
BR2_PACKAGE_WPA_SUPPLICANT_CLI=y
BR2_PACKAGE_HOSTAPD=y
BR2_PACKAGE_DHCP=y
BR2_PACKAGE_DHCP_SERVER=y
BR2_PACKAGE_DNSMASQ=y

# VPN packages
BR2_PACKAGE_WIREGUARD_TOOLS=y
BR2_PACKAGE_WIREGUARD_LINUX_COMPAT=y
BR2_PACKAGE_OPENVPN=y
BR2_PACKAGE_STRONGSWAN=y

# Security packages
BR2_PACKAGE_OPENSSL=y
BR2_PACKAGE_OPENSSH=y
BR2_PACKAGE_FAIL2BAN=y
BR2_PACKAGE_IPTABLES=y
BR2_PACKAGE_NETFILTER_CONNTRACK=y

# System utilities
BR2_PACKAGE_UTIL_LINUX=y
BR2_PACKAGE_UTIL_LINUX_HWCLOCK=y
BR2_PACKAGE_UTIL_LINUX_MOUNT=y
BR2_PACKAGE_UTIL_LINUX_UMOUNT=y
BR2_PACKAGE_E2FSPROGS=y
BR2_PACKAGE_DOSFSTOOLS=y
BR2_PACKAGE_NANO=y
BR2_PACKAGE_HTOP=y
BR2_PACKAGE_CURL=y
BR2_PACKAGE_WGET=y
BR2_PACKAGE_RSYNC=y

# Development tools (optional)
BR2_PACKAGE_GDB=y
BR2_PACKAGE_STRACE=y
BR2_PACKAGE_TCPDUMP=y
BR2_PACKAGE_IPERF3=y

# Python for management scripts
BR2_PACKAGE_PYTHON3=y
BR2_PACKAGE_PYTHON3_SQLITE=y
BR2_PACKAGE_PYTHON_PIP=y
BR2_PACKAGE_PYTHON_SETUPTOOLS=y

# Web server for management interface
BR2_PACKAGE_LIGHTTPD=y
BR2_PACKAGE_LIGHTTPD_OPENSSL=y
BR2_PACKAGE_LIGHTTPD_PCRE=y

# Hardware support
BR2_PACKAGE_RPI_FIRMWARE=y
BR2_PACKAGE_RPI_FIRMWARE_VARIANT_PI4=y
BR2_PACKAGE_RPI_USERLAND=y

# Compression
BR2_PACKAGE_XZ=y
BR2_PACKAGE_GZIP=y

# Time synchronization
BR2_PACKAGE_CHRONY=y

# File systems
BR2_PACKAGE_SQUASHFS=y

# Image generation
BR2_ROOTFS_POST_IMAGE_SCRIPT="board/raspberrypi4-64/post-image.sh $(BR2_EXTERNAL_GATEWAY_PATH)/scripts/post-image.sh"
BR2_ROOTFS_POST_SCRIPT_ARGS="--add-pi4-miniuart-bt-overlay"
```

## gateway-os/build/configs/gateway-x86_64_defconfig
```kconfig
# Gateway OS Configuration for x86_64
# Buildroot configuration for VPN gateway appliance - PC/Server version

BR2_x86_64=y
BR2_x86_core2=y

# System configuration
BR2_SYSTEM_HOSTNAME="gateway"
BR2_SYSTEM_BANNER="Gateway OS - VPN Gateway Appliance (x86_64)"
BR2_SYSTEM_DHCP="eth0"
BR2_ROOTFS_OVERLAY="$(BR2_EXTERNAL_GATEWAY_PATH)/rootfs"
BR2_ROOTFS_POST_BUILD_SCRIPT="$(BR2_EXTERNAL_GATEWAY_PATH)/scripts/post-build.sh"
BR2_ROOTFS_POST_IMAGE_SCRIPT="$(BR2_EXTERNAL_GATEWAY_PATH)/scripts/post-image-x86.sh"

# Kernel
BR2_LINUX_KERNEL=y
BR2_LINUX_KERNEL_LATEST_VERSION=y
BR2_LINUX_KERNEL_USE_DEFCONFIG=y
BR2_LINUX_KERNEL_DEFCONFIG="x86_64"
BR2_LINUX_KERNEL_NEEDS_HOST_OPENSSL=y
BR2_LINUX_KERNEL_NEEDS_HOST_LIBELF=y

# Bootloader - GRUB2 for x86_64
BR2_TARGET_GRUB2=y
BR2_TARGET_GRUB2_BOOT_PARTITION="iso9660"
BR2_TARGET_GRUB2_INSTALL_TOOLS=y

# Filesystem - ISO9660 for bootable CD/DVD
BR2_TARGET_ROOTFS_CPIO=y
BR2_TARGET_ROOTFS_CPIO_GZIP=y
BR2_TARGET_ROOTFS_CPIO_UIMAGE=y
BR2_TARGET_ROOTFS_ISO9660=y
BR2_TARGET_ROOTFS_ISO9660_BOOT_MENU="$(BR2_EXTERNAL_GATEWAY_PATH)/bootloader/isolinux.cfg"
BR2_TARGET_ROOTFS_ISO9660_HYBRID=y

# Toolchain
BR2_TOOLCHAIN_BUILDROOT_GLIBC=y
BR2_PACKAGE_GLIBC_UTILS=y
BR2_TOOLCHAIN_BUILDROOT_CXX=y

# System tools
BR2_PACKAGE_BUSYBOX=y
BR2_PACKAGE_BUSYBOX_CONFIG="$(BR2_EXTERNAL_GATEWAY_PATH)/configs/busybox.config"
BR2_PACKAGE_SKELETON_INIT_SYSTEMD=y
BR2_PACKAGE_SYSTEMD=y
BR2_PACKAGE_SYSTEMD_NETWORKD=y
BR2_PACKAGE_SYSTEMD_RESOLVED=y
BR2_PACKAGE_SYSTEMD_LOGIND=y

# Hardware support for x86_64
BR2_PACKAGE_LINUX_FIRMWARE=y
BR2_PACKAGE_LINUX_FIRMWARE_RTL_81XX=y
BR2_PACKAGE_LINUX_FIRMWARE_RTL_87XX=y
BR2_PACKAGE_LINUX_FIRMWARE_RALINK=y
BR2_PACKAGE_LINUX_FIRMWARE_INTEL=y

# Network packages
BR2_PACKAGE_IPTABLES=y
BR2_PACKAGE_IPROUTE2=y
BR2_PACKAGE_WIRELESS_TOOLS=y
BR2_PACKAGE_WPA_SUPPLICANT=y
BR2_PACKAGE_WPA_SUPPLICANT_CLI=y
BR2_PACKAGE_HOSTAPD=y
BR2_PACKAGE_DHCP=y
BR2_PACKAGE_DHCP_SERVER=y
BR2_PACKAGE_DNSMASQ=y
BR2_PACKAGE_BRIDGE_UTILS=y
BR2_PACKAGE_ETHTOOL=y

# VPN packages
BR2_PACKAGE_WIREGUARD_TOOLS=y
BR2_PACKAGE_WIREGUARD_LINUX_COMPAT=y
BR2_PACKAGE_OPENVPN=y
BR2_PACKAGE_STRONGSWAN=y

# Security packages
BR2_PACKAGE_OPENSSL=y
BR2_PACKAGE_OPENSSH=y
BR2_PACKAGE_FAIL2BAN=y
BR2_PACKAGE_IPTABLES=y
BR2_PACKAGE_NETFILTER_CONNTRACK=y

# System utilities
BR2_PACKAGE_UTIL_LINUX=y
BR2_PACKAGE_UTIL_LINUX_HWCLOCK=y
BR2_PACKAGE_UTIL_LINUX_MOUNT=y
BR2_PACKAGE_UTIL_LINUX_UMOUNT=y
BR2_PACKAGE_UTIL_LINUX_FDISK=y
BR2_PACKAGE_E2FSPROGS=y
BR2_PACKAGE_DOSFSTOOLS=y
BR2_PACKAGE_PARTED=y
BR2_PACKAGE_NANO=y
BR2_PACKAGE_HTOP=y
BR2_PACKAGE_CURL=y
BR2_PACKAGE_WGET=y
BR2_PACKAGE_RSYNC=y

# Development tools
BR2_PACKAGE_GDB=y
BR2_PACKAGE_STRACE=y
BR2_PACKAGE_TCPDUMP=y
BR2_PACKAGE_IPERF3=y

# Python for management scripts
BR2_PACKAGE_PYTHON3=y
BR2_PACKAGE_PYTHON3_SQLITE=y
BR2_PACKAGE_PYTHON_PIP=y
BR2_PACKAGE_PYTHON_SETUPTOOLS=y

# Web server
BR2_PACKAGE_LIGHTTPD=y
BR2_PACKAGE_LIGHTTPD_OPENSSL=y
BR2_PACKAGE_LIGHTTPD_PCRE=y

# Hardware detection
BR2_PACKAGE_PCIUTILS=y
BR2_PACKAGE_USBUTILS=y
BR2_PACKAGE_HWDATA=y

# Compression
BR2_PACKAGE_XZ=y
BR2_PACKAGE_GZIP=y

# Time synchronization
BR2_PACKAGE_CHRONY=y

# File systems
BR2_PACKAGE_SQUASHFS=y

# Host tools
BR2_PACKAGE_HOST_DOSFSTOOLS=y
BR2_PACKAGE_HOST_GENIMAGE=y
BR2_PACKAGE_HOST_MTOOLS=y
BR2_PACKAGE_HOST_XORRISO=y

# Boot splash (optional)
BR2_PACKAGE_PLYMOUTH=y

# Live system support
BR2_PACKAGE_LIVE_BOOT=y
```
